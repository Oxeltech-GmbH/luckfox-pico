## board/luckfox/rootfs-overlay/opt/ElectronicTeam/eveusb/module/Kconfig
```kconfig
config USB_EVEUSB
	tristate "USB Network Gate by Electronic Team, Inc."
	depends on USB && USB_ARCH_HAS_HCD
        ---help---
	  Kernel module for USB Network Gate by Electronic Team, Inc.

	  To compile this driver as a module, choose M here; the module will be
	  called eveusb. If unsure, say N.
```
